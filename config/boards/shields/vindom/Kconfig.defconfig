## config/boards/shields/vindom/Kconfig.defconfig
```kconfig
# Copyright (c) 2020 The ZMK Contributors
# SPDX-License-Identifier: MIT

if SHIELD_VINDOM_LEFT

config ZMK_KEYBOARD_NAME
    default "vindom"

config ZMK_SPLIT_ROLE_CENTRAL
	default y
endif

if SHIELD_VINDOM_LEFT || SHIELD_VINDOM_RIGHT

config ZMK_SPLIT
    default y

endif
```

## config/boards/shields/vindom/Kconfig.shield
```kconfig
# Copyright (c) 2020 The ZMK Contributors
# SPDX-License-Identifier: MIT

config SHIELD_VINDOM_LEFT
    def_bool $(shields_list_contains,vindom_left)

config SHIELD_VINDOM_RIGHT
    def_bool $(shields_list_contains,vindom_right)
```
